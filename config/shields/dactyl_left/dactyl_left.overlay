
/ {
    chosen {
        zmk,matrix = &matrix;
    };

    matrix: matrix {
        compatible = "zmk,matrix";
        row-gpios = <&gpio0 2>, <&gpio0 3>, <&gpio0 4>, <&gpio0 5>, <&gpio0 6>;
        col-gpios = <&gpio1 0>, <&gpio1 1>, <&gpio1 2>, <&gpio1 3>, <&gpio1 4>, <&gpio1 5>;
        diode-direction = <ROW2COL>;
    };
};
